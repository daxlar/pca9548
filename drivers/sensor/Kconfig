## drivers/sensor/pca9548/Kconfig
```kconfig
config PCA9548
	bool "PCA9548 I2C Mux Driver Sensor"
	default n
	depends on I2C
	help
	  Enable driver for the PCA9548 Haptics Driver Sensor.
```

## dts/bindings/sensor/ti,pca9548.yaml
```yaml
description: Texas Instruments PCA9548 i2c mux driver sensor

compatible: "ti,pca9548"

include: ["i2c-device.yaml", "sensor-device.yaml"]

properties:
  reg:
    required: true
    description: device address on i2c bus
```
